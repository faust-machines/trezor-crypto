## zephyr/Kconfig
```kconfig
# Copyright (c) 2023 Faust Network, Inc

config LIBTREZOR
	bool "Enable trezor"
	help
	  This option enables the libtrezor as a Zephyr module.

config APP_LINK_WITH_TREZOR
	bool "Make libtrezor header file available to application"
	default y
	depends on LIBTREZOR
```
